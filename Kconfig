## sample.yaml
```yaml
common:
  harness: net
  tags:
    - net
    - wifi
    - ci_build
sample:
  description: Test mqtt messaging, wifi driver and APIs functionality
  name: mqtt
tests:
  sample.net.mqtt:
    build_only: true
    build_on_all: true
    integration_platforms:
      - nrf54lm20dk/nrf5420lmb/cpuapp
    platform_allow: 
      - nrf54lm20dk/nrf54lm20b/cpuapp
      - nrf54lm20dk/nrf54lm20b/cpuapp/ns
    extra_configs:
      - CONFIG_WIFI_CREDENTIALS_STATIC_SSID="Vodafone-8D96F1"
      - CONFIG_WIFI_CREDENTIALS_STATIC_PASSWORD="z2pTqpFMMX6jXdv3"
      - CONFIG_WIFI_CREDENTIALS_STATIC_TYPE_PSK=y
    extra_args:
      - CONFIG_BUILD_ONLY_NO_BLOBS=y
      - SHIELD=nrf7002eb2
  
```

## src/modules/display/Kconfig.display
```kconfig
#
# Copyright (c) 2023 Nordic Semiconductor
#
# SPDX-License-Identifier: LicenseRef-Nordic-5-Clause
#

menu "Display"
	depends on DISPLAY

# Next definition added by Paulus Schulinck (Github @PaulskPt)
# Added to resolve "undeclared" error
config MQTT_SAMPLE_DISPLAY_LOG_LEVEL
	int "Log level"
	default 2

config MQTT_SAMPLE_DISPLAY_THREAD_STACK_SIZE
	int "Thread stack size"
	default 4096

config CHARACTER_FRAMEBUFFER
	bool "char framebuffer flag"
	default y

config SSD1306
	bool "Use SSD1306 flag"
	default y

module = MQTT_SAMPLE_DISPLAY
module-str = Display
source "subsys/logging/Kconfig.template.log_config"

endmenu # MQTT_SAMPLE_DISPLAY
```

## src/modules/transport/Kconfig.transport
```kconfig
#! @file Kconfig
 #* @brief Kconfig configuration file
 #
 # @author A BLUE THING IN THE CLOUD S.L.U.
 #    ===  When the technology becomes art ===
 #
 # http://abluethinginthecloud.com
 # j.longares@abluethinginthecloud
 #
 # (c) A BLUE THING IN THE CLOUD S.L.U.
 #
 #

menu "Transport"
	depends on MQTT_HELPER
	depends on HW_ID_LIBRARY

config MQTT_SAMPLE_TRANSPORT_RECONNECTION_TIMEOUT_SECONDS
	int "Reconnection timeout in seconds"
	default 60
	help
	  Time in between reconnection attempts to the MQTT broker.

config MQTT_SAMPLE_TRANSPORT_THREAD_STACK_SIZE
	int "Thread stack size"
	default 2048

config MQTT_SAMPLE_TRANSPORT_MESSAGE_QUEUE_SIZE
	int "Message queue size"
	default 5
	help
	  ZBus subscriber message queue size.

config MQTT_SAMPLE_TRANSPORT_WORKQUEUE_STACK_SIZE
	int "Workqueue stack size"
	default 4096
	help
	  Stack size of the module's internal workqueue.

config MQTT_SAMPLE_TRANSPORT_BROKER_HOSTNAME
	string "MQTT broker hostname"
	default "RPiCM5.local" # was: "test.mosquitto.org"

config MQTT_SAMPLE_TRANSPORT_HELPER_STATIC_IP_ADDRESS
	string "MQTT broker static IP address"
	default "192.168.1.114"

config MQTT_SAMPLE_TRANSPORT_CLIENT_ID
	string "MQTT Client ID"
	default "NordicMQTTClient"
	help
	  Use a custom client ID string. If not set, the client ID will default to the
	  modem's IMEI number for nRF9160 boards, MAC address for the nRF7002 DK,
	  or a random number for Native Posix.

config MQTT_SAMPLE_TRANSPORT_CLIENT_ID_BUFFER_SIZE
	int "MQTT Client ID buffer size"
	default 50
	help
	  Size of buffer used to store the MQTT client ID.

config MQTT_SAMPLE_TRANSPORT_DO_PUBLISH
    bool "Enable MQTT message publishing"
    default n
    help
      When enabled, the application will actively publish MQTT messages.
      If disabled, the publish function will return early without sending data.


config MQTT_SAMPLE_TRANSPORT_PUBLISH_TOPIC
	string "MQTT publish topic"
	default "my/publish/topic"

config MQTT_SAMPLE_TRANSPORT_SUBSCRIBE_TOPIC
	string "MQTT subscribe topic"
	default "sensors/Feath/ambient"

config MQTT_SAMPLE_TRANSPORT_BROKER_USERNAME
	string "MQTT username"
	default "noUser"

config MQTT_SAMPLE_TRANSPORT_BROKER_PASSWORD
	string "MQTT password"
	default "noPassword"

config MQTT_SAMPLE_TRANSPORT_MESSAGE
	string "MQTT message"
	default "message"

module = MQTT_SAMPLE_TRANSPORT
module-str = Transport
source "subsys/logging/Kconfig.template.log_config"


endmenu # Transport
```
